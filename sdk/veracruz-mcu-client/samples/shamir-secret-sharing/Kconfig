## sdk/veracruz-mcu-client/samples/shamir-secret-sharing/Kconfig
```kconfig
# Veracruz MCU Client example Kconfig configuration
#
# AUTHORS
#
# The Veracruz Development Team.
#
# COPYRIGHT AND LICENSING
#
# See the `LICENSE.md` file in the Veracruz root directory for
# licensing and copyright information.

source "Kconfig.zephyr"

config VC_SHAMIR_SECRET_SHARING_BINARY_PATH
    string "Absolute path to binary to use for Veracruz computation"
    default "binary.wasm"
    help
        This binary is built into the image and uploaded to Veracruz
```

## veracruz-mcu-client/Kconfig.vc
```kconfig
# Veracruz MCU Client Kconfig configuration
#
# These values can be overridden by applications that include this module
#
# AUTHORS
#
# The Veracruz Development Team.
#
# COPYRIGHT AND LICENSING
#
# See the `LICENSING.markdown` file in the Veracruz root directory for
# licensing and copyright information.

config VC
    bool "Veracruz MCU Client"
    default n
    help
        This option enables the Veracruz MCU Client

if VC

config VC_POLICY_PATH
    string "Absolute path to the policy.json file"
    default "policy.json"
    help
        This must be set to the absolute path to the policy.json
        file that governs the computation.

config VC_IDENTITY_PATH
    string "Absolute path to the public key of the device"
    default "cert.pem"
    help
        This must be set to the absolute path to the public key
        that represents the identity of the device.

config VC_KEY_PATH
    string "Absolute path to the private key of the device"
    default "key.pem"
    help
        This must be set to the absolute path to the private key
        of the device.

config VC_LOG
    bool "Enable logging"
    default y
    help
        Enables log output of Veracruz's internal state, by default
        this is fairly readable. More info can be printed via
        the VC_LOG_HEXDUMPS option.

config VC_LOG_HEXDUMPS
    bool "Enable hexdump logging"
    depends on VC_LOG
    default n
    help
        Enables hexdumps of various bits of data, such as the client/peer
        certificates, handshake messages, etc. Useful for debugging, but
        may leak secrets if used in production.

config VC_SEND_BUFFER_SIZE
    int "Size of Veracruz's send buffer"
    default 2048
    help
        The size of Veracruz's send buffer in bytes.

config VC_RECV_BUFFER_SIZE
    int "Size of Veracruz's recv buffer"
    default 4096
    help
        The size of Veracruz's recv buffer in bytes.

endif
```

## veracruz-mcu-client/samples/audio-event-triangulation/Kconfig
```kconfig
# Veracruz MCU Client example Kconfig configuration
#
# AUTHORS
#
# The Veracruz Development Team.
#
# COPYRIGHT AND LICENSING
#
# See the `LICENSING.markdown` file in the Veracruz root directory for
# licensing and copyright information.

source "Kconfig.zephyr"

config VC_AUDIO_EVENT_TRIANGULATION_CLAPS_PATH
    string "Absolute path to a .wav file containing clap audio"
    default "claps.wav"
    help
        Absolute path to a .wav file containing clap audio, this file can
        contain multiple claps which will get sliced up according to the
        VC_AUDIO_EVENT_TRIANGULATION_CLAP_NUMBER configuration option.

config VC_AUDIO_EVENT_TRIANGULATION_CLAP_BITRATE
    int "Bitrate of the audio sample to use for storing clap audio"
    default 100
    help
        Bitrate of the audio sample to use for storing clap audio. A naive
        downsampling algorithm is used to reduce the bitrate of the given
        wave file before storing on the device. Larger values give more audio
        information but take up more space.

        It's worth noting that a high bitrate is not required to determine
        peak amplitude/distance

config VC_AUDIO_EVENT_TRIANGULATION_CLAP_SAMPLES_BEFORE
    int "Number of samples before clap to include in window"
    default 30

config VC_AUDIO_EVENT_TRIANGULATION_CLAP_SAMPLES_AFTER
    int "Number of samples after clap to include in window"
    default 170

config VC_AUDIO_EVENT_TRIANGULATION_CLAP_NUMBER
    int "Integer index of which clap to use"
    default 0
    help
        Integer index of which clap to use out of claps.wav, these are
        found by naive peak detection after downsampling, clap 0 indicates
        the strongest peak, clap 1, indicates the second strongest peak, etc.

config VC_AUDIO_EVENT_TRIANGULATION_DELAY
    int "Artificial delay to introduce for demo purposes"
    default 0
    help
        Artificial delay to introduce for demo purposes, given in seconds.
```

## veracruz-mcu-client/samples/shamir-secret-sharing/Kconfig
```kconfig
source "Kconfig.zephyr"

config VC_SHAMIR_SECRET_SHARING_BINARY_PATH
    string "Absolute path to binary to use for Veracruz computation"
    default "binary.wasm"
    help
        This binary is built into the image and uploaded to Veracruz
```
